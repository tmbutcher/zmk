## app/boards/arm/nrf52840_m2/Kconfig.defconfig
```kconfig
# Copyright (c) 2020 The ZMK Contributors
# SPDX-License-Identifier: MIT

if BOARD_NRF52840_M2

config BOARD
	default "nrf52480_m2"

if USB_DEVICE_STACK

config USB_NRFX
	default y

endif # USB_DEVICE_STACK

config BT_CTLR
	default BT

config ZMK_BLE
	default y

config ZMK_USB
	default y

config ZMK_KEYBOARD_NAME
    default "adafruit_feather_nrf52840"

endif # BOARD_NRF52840_M2
```

## app/boards/shields/DPAD/Kconfig.defconfig
```kconfig
# Copyright (c) 2021 Tom Butcher
# SPDX-License-Identifier: MIT

if DPAD

config ZMK_KEYBOARD_NAME
    default "dpad"
	
endif
```

## app/boards/shields/DPAD/Kconfig.shield
```kconfig
# Copyright (c) 2021 Tom Butcher
# SPDX-License-Identifier: MIT

config SHIELD_DPAD
    def_bool $(shields_list_contains,dpad)
```

## app/boards/shields/demo/Kconfig.defconfig
```kconfig
# Copyright (c) 2022 The ZMK Contributors
# SPDX-License-Identifier: MIT

<<<<<<<< HEAD:app/boards/arm/pillbug/Kconfig.board
config BOARD_PILLBUG
    bool "PillBug"
    depends on SOC_NRF52840_QIAA
========
if SHIELD_DEMO

config ZMK_KEYBOARD_NAME
    default "Demo"

endif
>>>>>>>> pim-demo:app/boards/shields/demo/Kconfig.defconfig
```

## app/boards/shields/demo/Kconfig.shield
```kconfig
# Copyright (c) 2022 The ZMK Contributors
# SPDX-License-Identifier: MIT

config SHIELD_DEMO
	def_bool $(shields_list_contains,demo)
```

## app/boards/shields/demotle/Kconfig.shield
```kconfig
# Copyright (c) 2023 Tom Butcher
# SPDX-License-Identifier: MIT

config SHIELD_DEMOTLE_LEFT
    def_bool $(shields_list_contains,demotle_left)

config SHIELD_DEMOTLE_RIGHT
    def_bool $(shields_list_contains,demotle_right)
```

## app/boards/shields/pim_demo/Kconfig.shield
```kconfig
# Copyright (c) 2021 Tom Butcher
# SPDX-License-Identifier: MIT

config SHIELD_PIM_DEMO
    def_bool $(shields_list_contains,pim_demo)
```

## app/boards/shields/space_invader/Kconfig.defconfig
```kconfig
# Copyright (c) 2021 Tom Butcher
# SPDX-License-Identifier: MIT

if SPACE_INVADER

config ZMK_KEYBOARD_NAME
    default "Space Invader"

endif
```

## app/boards/shields/space_invader/Kconfig.shield
```kconfig
# Copyright (c) 2021 Tom Butcher
# SPDX-License-Identifier: MIT

config SHIELD_SPACE_INVADER
    def_bool $(shields_list_contains,space_invader)
```

## app/boards/shields/splayt_demo/Kconfig.shield
```kconfig
# Copyright (c) 2021 Tom Butcher
# SPDX-License-Identifier: MIT

config SHIELD_SPLAYT_DEMO
    def_bool $(shields_list_contains,splayt_demo)
```

## app/boards/shields/splayt_demo_choc/Kconfig.shield
```kconfig
# Copyright (c) 2021 Tom Butcher
# SPDX-License-Identifier: MIT

config SHIELD_SPLAYT_DEMO_CHOC
    def_bool $(shields_list_contains,splayt_demo_choc)
```

## app/boards/shields/splayt_demo_mx/Kconfig.defconfig
```kconfig
# Copyright (c) 2021 Tom Butcher
# SPDX-License-Identifier: MIT

if SPLAYT_DEMO_MX

config ZMK_KEYBOARD_NAME
    default "splayt-demo-mx"

endif
```
