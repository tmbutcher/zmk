#include <dt-bindings/zmk/mouse.h>

&mmv {
  time-to-max-speed-ms = <500>;
  acceleration-exponent = <3>;
};

&msc {
  time-to-max-speed-ms = <0>;
  acceleration-exponent = <0>;
};

#define U_MOUSE_MOVE_MAX 1500 // 3000
#define S_MOUSE_MOVE_MAX 350 // 500
#define U_MOUSE_SCROLL_MAX 75 // 100

#undef MOVE_UP
#undef MOVE_DOWN
#undef MOVE_LEFT
#undef MOVE_RIGHT
#define MOVE_UP MOVE_Y(-U_MOUSE_MOVE_MAX)
#define MOVE_DOWN MOVE_Y(U_MOUSE_MOVE_MAX)
#define MOVE_LEFT MOVE_X(-U_MOUSE_MOVE_MAX)
#define MOVE_RIGHT MOVE_X(U_MOUSE_MOVE_MAX)

#define MOVE_UP_SLOW MOVE_Y(-S_MOUSE_MOVE_MAX)
#define MOVE_DOWN_SLOW MOVE_Y(S_MOUSE_MOVE_MAX)
#define MOVE_LEFT_SLOW MOVE_X(-S_MOUSE_MOVE_MAX)
#define MOVE_RIGHT_SLOW MOVE_X(S_MOUSE_MOVE_MAX)

#define M_UP MOVE_UP
#define M_DN MOVE_DOWN
#define M_LT MOVE_LEFT
#define M_RT MOVE_RIGHT

#define MUPS MOVE_UP_SLOW
#define MDNS MOVE_DOWN_SLOW
#define MLTS MOVE_LEFT_SLOW
#define MRTS MOVE_RIGHT_SLOW

#undef SCRL_UP
#undef SCRL_DOWN
#undef SCRL_LEFT
#undef SCRL_RIGHT
#define SCRL_UP MOVE_Y(U_MOUSE_SCROLL_MAX)
#define SCRL_DOWN MOVE_Y(-U_MOUSE_SCROLL_MAX)
#define SCRL_LEFT MOVE_X(-U_MOUSE_SCROLL_MAX)
#define SCRL_RIGHT MOVE_X(U_MOUSE_SCROLL_MAX)

#define S_UP SCRL_UP
#define S_DN SCRL_DOWN
#define S_LT SCRL_LEFT
#define S_RT SCRL_RIGHT
