/*
 * Copyright (c) 2021 Tom Butcher
 *
 * SPDX-License-Identifier: MIT
 */

#include <dt-bindings/zmk/matrix_transform.h>

/ {
	chosen {
		zmk,kscan = &kscan0;
		zephyr,console = &cdc_acm_uart;
	};

	kscan0: kscan_0 {
		compatible = "zmk,kscan-gpio-direct";
		label = "KSCAN";

		input-gpios
			= <&gpio0 6 (GPIO_ACTIVE_LOW | GPIO_PULL_UP)>
			, <&gpio0 8 (GPIO_ACTIVE_LOW | GPIO_PULL_UP)>
			, <&gpio0 17 (GPIO_ACTIVE_LOW | GPIO_PULL_UP)>
			, <&gpio0 20 (GPIO_ACTIVE_LOW | GPIO_PULL_UP)>
			;
	};
};

