#include "demotle.dtsi"

&kscan0 {
    col-gpios
    = <&gpio1 13 GPIO_ACTIVE_HIGH> // pro_micro 15
	, <&gpio1 15 GPIO_ACTIVE_HIGH> // pro_micro 18
	, <&gpio0 2 GPIO_ACTIVE_HIGH> // pro_micro 19
	, <&gpio0 29 GPIO_ACTIVE_HIGH> // pro_micro 20
	, <&gpio0 31 GPIO_ACTIVE_HIGH> // pro_micro 21
	;
};
