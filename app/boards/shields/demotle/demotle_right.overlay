#include "demotle.dtsi"

&default_transform { // Because the left half has columns 1-5
    col-offset = <5>;
};

&kscan0 {
    col-gpios
    = <&gpio0 31 GPIO_ACTIVE_HIGH> // pro_micro 21
	, <&gpio0 29 GPIO_ACTIVE_HIGH> // pro_micro 20
	, <&gpio0 2 GPIO_ACTIVE_HIGH> // pro_micro 19
	, <&gpio1 15 GPIO_ACTIVE_HIGH> // pro_micro 18
	, <&gpio1 13 GPIO_ACTIVE_HIGH> // pro_micro 15
	;
};
