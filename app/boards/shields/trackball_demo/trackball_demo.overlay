/*
 * Copyright (c) 2022 The ZMK Contributors
 *
 * SPDX-License-Identifier: MIT
 */

/ {
	chosen {
		zmk,kscan = &kscan0;
	};

	// kscan0: kscan {
	// 	compatible = "zmk,kscan-gpio-direct";

	// 	label = "KSCAN";

	// 	input-gpios
	// 		= <&pro_micro 4 (GPIO_ACTIVE_LOW | GPIO_PULL_UP)>
	// 		, <&pro_micro 5 (GPIO_ACTIVE_LOW | GPIO_PULL_UP)>
	// 		;

	// };

	&i2c0 {
		compatible = "nordic,nrf-twi";
		pinctrl-0 = <&i2c0_default>;
		pinctrl-1 = <&i2c0_sleep>;
		pinctrl-names = "default", "sleep";
	};

};